## config/west.yml
```yaml
manifest:
  remotes:
    - name: zmkfirmware
      url-base: https://github.com/zmkfirmware
    - name: urob
      url-base: https://github.com/urob
  projects:
    - name: zmk
      remote: zmkfirmware
      revision: main
      import: app/west.yml
    - name: zmk-rgbled-widget   # https://github.com/caksoylar/zmk-rgbled-widget
      remote: caksoylar
      # url: https://github.com/caksoylar/zmk-rgbled-widget
      revision: main
    - name: zmk-leader-key
      remote: urob
      revision: main
    - name: zmk-auto-layer      # https://github.com/urob/zmk-auto-layer
      remote: urob
      revision: main
    - name: zmk-tri-state       # https://github.com/urob/zmk-tri-state
      remote: urob
      revision: main
    # - name: zmk-userspace
    #   remote: elpekenin
    #   revision: main

  self:
    path: config
```
